## package/bluez-hcidump/Config.in
```kconfig
config BR2_PACKAGE_BLUEZ_HCIDUMP
	bool "bluez-hcidump"
	select BR2_PACKAGE_DBUS
	help
	  bluez utils

	   http://pkgs.fedoraproject.org/repo/pkgs/bluez-hcidump/
```

## package/ccid/Config.in
```kconfig
config BR2_PACKAGE_CCID
	bool "ccid"
	select BR2_PACKAGE_PCSCLITE

	help
	  Userspace library for accessing USB devices

	  http://alioth.debian.org/
```

## package/check/Config.in
```kconfig
config BR2_PACKAGE_CHECK
	bool"check"
	help
	 check is a simple interface for defining unit test.

	 http://downloads.sourceforge.net/check/
```

## package/glib/Config.in
```kconfig
config BR2_PACKAGE_GLIB
	bool "glib"
	depends on BR2_PACKAGE_DBUS
	help
	 GLib is a library of utility functions designed to solve some portability 
	 problems and provide other useful functionality which most programs require 

	  http://ftp.gnome.org/pub/GNOME/sources/glib/2.24/
```

## package/obex-data-server/Config.in
```kconfig
config BR2_PACKAGE_OBEXDATASERVER
	bool "obex-data-server"
	depends on BR2_PACKAGE_OPENOBEX
	help
	  obex-data-server is D-Bus service providing high-level 
	  OBEX client and server side functionality.

	  http://tadas.dailyda.com/software/


	
```

## package/obexd/Config.in
```kconfig
config BR2_PACKAGE_OBEXD
	bool "obexd"
	help
	  obexd is a D-Bus enabled OBEX client daemon that allow easy 
	  integration of OBEX based Bluetooth profiles.

	  http://www.kernel.org/pub/linux/bluetooth
```

## package/openobex/Config.in
```kconfig
config BR2_PACKAGE_OPENOBEX
	bool "openobex"
	depends on BR2_PACKAGE_LIBUSB
	select BR2_PACKAGE_DBUS
	help
	  openobex libarys to access bluez



            http://jaist.dl.sourceforge.net/project/pocketbook-free/PocketBook_Free_Linux_Sources
	
```

## package/opensc/Config.in
```kconfig
config BR2_PACKAGE_OPENSC
	bool "opensc"

	select BR2_PACKAGE_LIBUSB
	help
	  Userspace library for accessing USB devices

	   http : //www.opensc-project.org/
```

## package/pcsclite/Config.in
```kconfig
config BR2_PACKAGE_PCSCLITE
	bool "pcsclite"
	 select BR2_PACKAGE_LIBUSB
	help
	  Userspace library for accessing USB devices

	  http://alioth.debian.org/
```
